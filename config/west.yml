## config/west.yml
```yaml
manifest:
  remotes:
    - name: moergo-sc
      url-base: https://github.com/moergo-sc
  projects:
    - name: zmk
      remote: moergo-sc
      revision: 11454d23596afbdb06380a1125371b19ab65675c  # v25.11 (2025-11-26)
      import: app/west.yml
  self:
    path: config
```
